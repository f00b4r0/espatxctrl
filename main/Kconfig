## main/Kconfig
```kconfig
menu "espatxctrl"

# defaults for WT32-ETH01

config ESPATXCTRL_CONSOLE_UART_NUM
    int "Serial console UART"
    default 2
    help
        UART peripheral to use for console passthrough

config ESPATXCTRL_CONSOLE_UART_BAUDRATE
    int "Serial console baudrate"
    default 115200

config ESPATXCTRL_CONSOLE_UART_TXD
    int "UART TXD pin"
    default 17

config ESPATXCTRL_CONSOLE_UART_RXD
    int "UART RXD pin"
    default 5

config ESPATXCTRL_LISTEN_PORT
    int "TCP listen port"
    default 23

config ESPATXCTRL_GPIO_OUT_POWER
    int "Power control output GPIO"
    default 32

config ESPATXCTRL_GPIO_OUT_RESET
    int "Reset control output GPIO"
    default 33

config ESPATXCTRL_GPIO_IN_LEDPOWER
    int "Power LED input GPIO"
    default 4

config ESPATXCTRL_GPIO_IN_LEDHDD
    int "HDD LED input GPIO"
    default 14

config ESPATXCTRL_HAS_LEDHB
    bool "Use hearbeat LED"
    default n

config ESPATXCTRL_LEDHD_GPIO
    int "Heartbeat LED GPIO"
    depends on ESPATXCTRL_HAS_LEDHB
    default 2

endmenu
```

## sdkconfig.defaults
```kconfig
CONFIG_BOOTLOADER_APP_ROLLBACK_ENABLE=y
CONFIG_PARTITION_TABLE_TWO_OTA=y
CONFIG_ESPTOOLPY_FLASHSIZE_4MB=y
CONFIG_ETH_USE_SPI_ETHERNET=n
CONFIG_MBEDTLS_CERTIFICATE_BUNDLE=n
CONFIG_COMPILER_OPTIMIZATION_SIZE=y
CONFIG_COMPILER_WARN_WRITE_STRINGS=y
CONFIG_ESP_INT_WDT=y
CONFIG_ESP_TASK_WDT_INIT=y
CONFIG_ESP_TASK_WDT_PANIC=y
CONFIG_ESP_NETIF_TCPIP_ADAPTER_COMPATIBLE_LAYER=n
CONFIG_UART_ISR_IN_IRAM=y
CONFIG_PM_ENABLE=y
CONFIG_PM_DFS_INIT_AUTO=y
CONFIG_LWIP_SO_REUSE=y
CONFIG_LWIP_SO_REUSE_RXTOALL=n
CONFIG_LWIP_DHCPS=n
CONFIG_LWIP_IPV6=n
CONFIG_LWIP_NETIF_LOOPBACK=n
CONFIG_NEWLIB_NANO_FORMAT=y
CONFIG_SPI_FLASH_ENABLE_ENCRYPTED_READ_WRITE=n
CONFIG_WS_TRANSPORT=n
CONFIG_VFS_SUPPORT_DIR=n
CONFIG_VFS_SUPPORT_TERMIOS=n
CONFIG_SIMPLE_PUSHOTA_ENABLED=y
CONFIG_SIMPLE_NETWORK_NOIP_REBOOT=y
CONFIG_SIMPLE_NETWORK_ETH_WT32=y
```
